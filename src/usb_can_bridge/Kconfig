## src/usb_can_bridge/Kconfig
```kconfig
source "Kconfig.zephyr"

config WBR_UART10_LINE_IDLE
    bool "Dust V3 UART10 RX-line idle via TRGM1 and GPTMR2"
    default y
    depends on BOARD_DUST_HPM6750 && UART_ASYNC_API && UART_INTERRUPT_DRIVEN
    help
      Uses PB13/TRGM1_P03 (wired to UART10_RXD), GPTMR2 channels 0/2,
      and a 1000-us line-idle threshold. Retains 128-byte double buffers.
      UART FIFO RX interrupts are disabled; DMA completion stays enabled.

config WBR_CONTROL_ONBOARD_IMU_RAW
    bool "Acquire raw onboard IMU bursts without a controller or AHRS"
    default y

config WBR_CONTROL_ONBOARD_IMU_SPI_FREQUENCY_HZ
    int "Onboard IMU SPI frequency"
    default 8000000
    range 100000 24000000
    depends on WBR_CONTROL_ONBOARD_IMU_RAW
```
