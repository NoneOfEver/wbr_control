## CMakeLists.txt
```
# SPDX-License-Identifier: Apache-2.0

cmake_minimum_required(VERSION 3.20.0)

# T2: hpm_support is a project, not manifest repo.
# Compute paths relative to wbr_control location (workspace root).
set(HPM_ZEPHYR_DIR ${CMAKE_CURRENT_SOURCE_DIR}/../hpm_support)
set(HPM_SDK_DIR ${CMAKE_CURRENT_SOURCE_DIR}/../../sdk_env/hpm_sdk)
set(HPM_ENV_DIR ${CMAKE_CURRENT_SOURCE_DIR}/../../sdk_env)
# Eigen：纯头文件线性代数库，位于 workspace 根（../eigen）。
set(EIGEN_DIR ${CMAKE_CURRENT_SOURCE_DIR}/../eigen)
# Sophus：纯头文件李群库，作为 west project 位于 workspace 根（../sophus）。
set(SOPHUS_DIR ${CMAKE_CURRENT_SOURCE_DIR}/../sophus)
set(FATFS_DIR ${CMAKE_CURRENT_SOURCE_DIR}/../fatfs)

set(CMAKE_EXPORT_COMPILE_COMMANDS ON)

list(APPEND BOARD_ROOT ${HPM_ZEPHYR_DIR})

find_package(Zephyr REQUIRED HINTS $ENV{ZEPHYR_BASE})
project(wbr_control)

# Validate the resolved configuration after Kconfig so UART0 remains reserved
# for the binary oscilloscope stream.
if(NOT CONFIG_UART_ASYNC_API)
  message(FATAL_ERROR
    "The UART0 oscilloscope output requires CONFIG_UART_ASYNC_API=y")
endif()

target_include_directories(app PRIVATE
  ${PROJECT_SOURCE_DIR}
  ${PROJECT_SOURCE_DIR}/src
)
target_include_directories(app SYSTEM PRIVATE ${EIGEN_DIR})
target_include_directories(app SYSTEM PRIVATE ${FATFS_DIR}/include)
if(EXISTS ${SOPHUS_DIR}/sophus/so3.hpp)
  target_include_directories(app SYSTEM PRIVATE ${SOPHUS_DIR})
endif()

if(CONFIG_CHERRYUSB)
  set(CHERRYUSB_CONFIG_DIR ${HPM_ZEPHYR_DIR}/samples/cherryusb/config)
  zephyr_include_directories(${CHERRYUSB_CONFIG_DIR})
  zephyr_include_directories(${HPM_SDK_DIR}/components/usb/device)
endif()

target_sources(app PRIVATE
  src/main.cpp
)

# 模块仅由 main 线程顺序构造，关闭局部静态对象的线程安全初始化守卫。
target_compile_options(app PRIVATE
  -fno-threadsafe-statics
)

add_subdirectory(channels)
add_subdirectory(src/protocols)
add_subdirectory(src/scheduling)
add_subdirectory(src/modules)
add_subdirectory(platform)
add_subdirectory(debug)

# 应用入口只直接依赖模块、通道和平台；协议由模块目标自行声明。
target_link_libraries(app PRIVATE
  wbr_channels
  wbr_modules
  wbr_platform
)

if(TARGET wbr_debug)
  target_link_libraries(app PRIVATE wbr_debug)
endif()
```

## Kconfig
```
# SPDX-License-Identifier: Apache-2.0

source "Kconfig.zephyr"

menu "wbr_control application options"

config WBR_CONTROL_RTT_DIAGNOSTICS
	bool "Enable shell, logging and printk diagnostics over SEGGER RTT"
	depends on HAS_SEGGER_RTT
	select USE_SEGGER_RTT
	select SHELL
	select SHELL_BACKEND_RTT
	select SHELL_LOG_BACKEND
	select LOG
	select LOG_PRINTK
	select PRINTK
	help
	  Route the interactive shell, LOG_* messages and printk() through the
	  RTT shell backend. This path is independent of UART0, so it can remain
	  enabled while UART0 carries the binary VOFA oscilloscope stream.

config WBR_CONTROL_MODULE_REMOTE_INPUT
	bool "Enable remote_input module"
	default y
	help
	  Enable registering and starting the remote_input module.

config WBR_CONTROL_MODULE_CHASSIS
	bool "Enable chassis module"
	default y
	help
	  Register and start the 1 kHz independent-leg chassis controller.

config WBR_CONTROL_MODULE_REFEREE
	bool "Enable referee module"
	default n
	help
	  Enable registering and starting the referee module.

config WBR_CONTROL_MODULE_OSCILLOSCOPE
	bool
	default y
	help
	  UART0 is permanently reserved for the VOFA oscilloscope binary stream.
	  Diagnostics use SEGGER RTT instead of UART0.

config WBR_CONTROL_OSCILLOSCOPE_UART_BAUDRATE
	int "VOFA oscilloscope UART baudrate"
	default 921600
	depends on WBR_CONTROL_MODULE_OSCILLOSCOPE
	help
	  UART0 baudrate used by the VOFA+ oscilloscope output.

config WBR_CONTROL_OSCILLOSCOPE_PERIOD_MS
	int "VOFA oscilloscope output period in milliseconds"
	default 10
	depends on WBR_CONTROL_MODULE_OSCILLOSCOPE
	help
	  Output period for the VOFA+ oscilloscope module. A value of 10 ms
	  gives 100 Hz output.

config WBR_CONTROL_MODULE_HI91_IMU
	bool "Enable HI91 IMU module"
	default n
	depends on SERIAL && UART_ASYNC_API
	help
	  Enable the HI91 external IMU module on UART2. The module parses HI91
	  binary frames and publishes the latest IMU sample to channels.

config WBR_CONTROL_MODULE_AHRS
	bool "Enable onboard AHRS module"
	default n
	depends on SPI && SPI_ASYNC && SPI_HPM_SPI_DMA && GPIO
	help
	  Enable the board AHRS. Its single thread owns the onboard ICM42688P-HXY,
	  performs asynchronous SPI HDMA reads, calibrates gyro bias, and updates
	  the quaternion EKF estimator from each completed sample.
	  Devicetree aliases onboard-imu-cs and onboard-imu-drdy must describe the
	  custom PCB connections.

config WBR_CONTROL_ONBOARD_IMU_SPI_FREQUENCY_HZ
	int "Onboard ICM42688P SPI frequency"
	default 8000000
	range 100000 24000000
	depends on WBR_CONTROL_MODULE_AHRS
	help
	  SPI2 bus frequency used for register access and 12-byte six-axis
	  burst reads. Start conservatively if PCB signal integrity is unknown.

config WBR_CONTROL_ONBOARD_IMU_CALIBRATION_SAMPLES
	int "Stationary gyro calibration sample count"
	default 1000
	range 100 5000
	depends on WBR_CONTROL_MODULE_AHRS
	help
	  Number of consecutive stationary 1 kHz AHRS samples used to estimate the
	  startup gyro bias. The proven BMI088 implementation used a one-second,
	  1000-sample average. The counter resets if motion is detected, so the
	  robot must remain still until calibration completes.

config WBR_CONTROL_ONBOARD_IMU_BODY_MAP_CONFIRMED
	bool "Onboard IMU sensor-to-body map verified on hardware"
	default n
	depends on WBR_CONTROL_MODULE_AHRS
	help
	  Enable only after physically rotating the assembled robot around each
	  body axis and verifying the configured axis order and signs. The chassis
	  cannot select the onboard IMU until this acknowledgement is enabled.

choice WBR_CONTROL_CHASSIS_IMU_SOURCE
	prompt "Chassis attitude source"
	default WBR_CONTROL_CHASSIS_IMU_HI91
	depends on WBR_CONTROL_MODULE_CHASSIS

config WBR_CONTROL_CHASSIS_IMU_HI91
	bool "HI91 external IMU"
	depends on WBR_CONTROL_MODULE_HI91_IMU

config WBR_CONTROL_CHASSIS_IMU_ONBOARD_EKF
	bool "Onboard IMU quaternion EKF attitude"
	depends on WBR_CONTROL_MODULE_AHRS && WBR_CONTROL_ONBOARD_IMU_BODY_MAP_CONFIRMED

endchoice

config WBR_CONTROL_HI91_IMU_UART_BAUDRATE
	int "HI91 IMU UART baudrate"
	default 921600
	depends on WBR_CONTROL_MODULE_HI91_IMU
	help
	  UART2 baudrate used by the HI91 external IMU module.

config WBR_CONTROL_HI91_IMU_STRICT_CRC
	bool "Reject HI91 frames with CRC mismatch"
	default n
	depends on WBR_CONTROL_MODULE_HI91_IMU
	help
	  Reject frames that do not match the built-in CRC16 check. Keep this
	  disabled until the exact CRC variant is confirmed from the device
	  manual or captured frames.

config WBR_CONTROL_MODULE_SYS_STATE
	bool "Enable status indicator module"
	default n
	depends on GPIO || PWM
	help
	  Enable registering and starting the system status indicator module.
	  The module supports RGB breathing LED and optional PWM buzzer output.

config WBR_CONTROL_MODULE_SDLOG
	bool "Enable FAT32 TF-card logging module"
	default n
	depends on FILE_SYSTEM && DISK_ACCESS && DISK_DRIVER_SDMMC && FAT_FILESYSTEM_ELM
	select FS_FATFS_EXFAT
	help
	  Enable the low-priority SD logger. The logger mounts an existing FAT32
	  volume at /SD:, records binary snapshots, and never blocks boot or the
	  control/sensor threads when the card is absent or fails.

config WBR_CONTROL_SHELL_MAVLINK_CONTROL
	bool "Enable MAVLink shell control command"
	default n
	depends on SHELL
	help
	  Enable `mavlink on/off/status` shell command. When enabled,
	  MAVLink bytes are received on the same shell UART by using shell bypass.

config WBR_CONTROL_RUNTIME_INIT_CAN
	bool "Initialize CAN dispatch in bootstrap"
	default y
	depends on CAN
	help
	  Enable CAN dispatch initialization during runtime bootstrap.

config WBR_CONTROL_RUNTIME_INIT_USB
	bool "Initialize USB session in bootstrap"
	default n
	depends on CHERRYUSB_DEVICE
	help
	  Enable CherryUSB Vendor Interrupt session initialization during runtime bootstrap.

config WBR_CONTROL_PC_LINK
	bool "Enable PC link protocol over USB"
	default y
	depends on WBR_CONTROL_RUNTIME_INIT_USB
	help
	  Enable the pc_link session worker inside usb_session. The worker
	  assembles the auto-aim telemetry packet from the gimbal/booster/imu/
	  remote_input channels at a fixed rate and parses auto-aim commands
	  received from the PC over USB Vendor Interrupt endpoints.

config WBR_CONTROL_PC_LINK_PERIOD_MS
	int "PC link send period in milliseconds"
	default 1
	depends on WBR_CONTROL_PC_LINK
	help
	  Period at which the pc_link worker publishes the auto-aim state frame.

config WBR_CONTROL_PC_LINK_COMMAND_TIMEOUT_MS
	int "PC link command timeout in milliseconds"
	range 10 5000
	default 100
	depends on WBR_CONTROL_PC_LINK
	help
	  Publish an idle command when no valid PC control frame has been received
	  within this interval. USB reset and disconnect also request an idle command.

endmenu
```

## west.yml
```
# T2: Star topology, application is the manifest repository.
# wbr_control is the manifest repository (application-as-manifest).
#
# West workspace configuration (.west/config):
#   [manifest]
#   path = wbr_control
#   file = west.yml

########################################
##  zephyr                    v3.7.0  ##
##  hpm_sdk                   v1.11.0 ##
########################################
manifest:
  version: "1.0"

  remotes:
    - name: github
      url-base: https://github.com/hpmicro
    - name: cherry-embedded
      url-base: https://github.com/cherry-embedded/
    - name: cherryusb-fork
      url-base: https://github.com/NoneOfEver
    - name: upstream
      url-base: https://github.com/zephyrproject-rtos
    - name: dust-mavlink
      url-base: https://github.com/NoneOfEver
    - name: dust-hpm
      url-base: https://github.com/HNUST-Dust
    # Eigen 官方仓库在 GitLab（GitHub 的 eigenteam/eigen-git-mirror 已停更在 3.3.7）。
    - name: eigen
      url-base: https://gitlab.com
    - name: sophus
      url-base: https://github.com/strasdat
    - name: tinympc
      url-base: https://github.com/NoneOfEver

  defaults:
    remote: github

  projects:
    # Zephyr RTOS. Third-party projects are declared explicitly below so every
    # repository can live directly under the workspace root.
    - name: zephyr
      remote: github
      repo-path: zephyr
      revision: zsg_v0.7.0
      west-commands: scripts/west-commands.yml

    # ELM FatFs implementation required by Zephyr's FAT filesystem layer.
    - name: fatfs
      remote: upstream
      repo-path: fatfs
      path: fatfs
      revision: 427159bf95ea49b7680facffaa29ad506b42709b

    # HPMicro SDK (manifest repo with boards, drivers, soc, dts)
    - name: hpm_support
      remote: dust-hpm
      repo-path: hpm_support
      path: hpm_support
      # Internally maintained dependency: always consume the latest main branch.
      revision: main
      west-commands: scripts/west-commands.yml

    # SEGGER RTT transport used by the non-UART shell/logging diagnostics.
    # Keep this revision aligned with the Zephyr 3.7 manifest.
    - name: segger
      remote: upstream
      repo-path: segger
      path: segger
      revision: b011c45b585e097d95d9cf93edf4f2e01588d3cd

    - name: CherryUSB
      remote: cherryusb-fork
      repo-path: CherryUSB
      path: cherry_usb
      revision: 50c7e9085801e24d2d0991d0c4c1609fdbcfb90a

    # Mavlink generated headers
    - name: dust_mavlink
      remote: dust-mavlink
      repo-path: dust_mavlink
      path: mavlink
      revision: main

    # Eigen：纯头文件线性代数库（MPL-2.0），用于状态估计 / MPC / 坐标系变换。
    # 3.4.0 为当前最新稳定版，对应 commit 3147391d946bb4b6c68edd901f2add6ac1f31f8c。
    - name: eigen
      remote: eigen
      repo-path: libeigen/eigen
      path: eigen
      revision: 3.4.0

    # Sophus：基于 Eigen 的纯头文件李群库。固件仅使用固定尺寸 SO3f，禁止在
    # 1 kHz 实时路径中使用字符串 frame、动态缓存或失败格式化路径。
    - name: sophus
      remote: sophus
      repo-path: Sophus
      path: sophus
      revision: d0b7315a0d90fc6143defa54596a3a95d9fa10ec

    # TinyMPC：面向资源受限 MCU 的 MPC 求解器。目前只供独立 host test
    # 使用，尚未链接到正式 Zephyr 固件目标。
    - name: TinyMPC
      remote: tinympc
      repo-path: TinyMPC
      path: tiny_mpc
      revision: 023f36bd5b27267e1a96ed47a774d120b5707f13

  self:
    path: wbr_control
    west-commands: scripts/west-commands.yml
```

## prj.conf
```kconfig
CONFIG_CONSOLE=y
CONFIG_SERIAL=y
CONFIG_UART_CONSOLE=y
CONFIG_PRINTK=y
CONFIG_CPP=y
CONFIG_STD_CPP17=y
CONFIG_REQUIRES_FULL_LIBCPP=y
CONFIG_ZBUS=y
CONFIG_RING_BUFFER=y
CONFIG_LOG=y
CONFIG_LOG_BACKEND_UART=y
CONFIG_LOG_PROCESS_THREAD_SLEEP_MS=100
CONFIG_UART_ASYNC_API=y
CONFIG_UART_INTERRUPT_DRIVEN=y
CONFIG_CAN=y
CONFIG_SHELL=n
CONFIG_SHELL_THREAD_PRIORITY_OVERRIDE=n
# CONFIG_SHELL_THREAD_PRIORITY=7
CONFIG_TIMESLICING=y
CONFIG_TIMESLICE_SIZE=1
CONFIG_THREAD_RUNTIME_STATS=y
CONFIG_THREAD_RUNTIME_STATS_USE_TIMING_FUNCTIONS=y
CONFIG_THREAD_ANALYZER=y
CONFIG_THREAD_ANALYZER_USE_PRINTK=y
CONFIG_FLASH=y
CONFIG_FLASH_MAP=y
CONFIG_FILE_SYSTEM=y
CONFIG_FILE_SYSTEM_MKFS=y
CONFIG_FILE_SYSTEM_SHELL=n
CONFIG_FILE_SYSTEM_LITTLEFS=y
CONFIG_DEBUG_COREDUMP=y
CONFIG_DEBUG_COREDUMP_BACKEND_LOGGING=y
CONFIG_DEBUG_COREDUMP_MEMORY_DUMP_MIN=y
CONFIG_DEBUG_COREDUMP_SHELL=n

CONFIG_CHERRYUSB=y
CONFIG_CHERRYUSB_DEVICE=y
CONFIG_CHERRYUSB_DEVICE_SPEED_AUTO=y
CONFIG_CHERRYUSB_DEVICE_HPM=y
CONFIG_CHERRYUSB_DEVICE_CDC_ACM=y

CONFIG_RM_TEST_RUNTIME_INIT_UART=y
CONFIG_RM_TEST_RUNTIME_INIT_CAN=y
CONFIG_RM_TEST_RUNTIME_INIT_USB=n
CONFIG_RM_TEST_RUNTIME_INIT_LITTLEFS=n
CONFIG_RM_TEST_SHELL_MAVLINK_CONTROL=n
CONFIG_RM_TEST_MODULE_REMOTE_INPUT=y
CONFIG_RM_TEST_MODULE_CHASSIS=y
CONFIG_RM_TEST_MODULE_GIMBAL=n
CONFIG_RM_TEST_MODULE_REFEREE=n
```

## src/main.cpp
```c
/*
 * SPDX-License-Identifier: Apache-2.0
 */

/**
* @file src/main.cpp
 * @ingroup wbr_control
 * @brief 实现应用或测试程序的入口与初始化流程。
 * @details 主入口按依赖顺序初始化平台服务和应用模块。任一必需模块启动失败都会保留诊断信息，避免在输入或执行器未就绪时进入闭环控制。
 */

#include <errno.h>

#include <zephyr/kernel.h>
#include <zephyr/logging/log.h>
#include <zephyr/sys/printk.h>
#include <zephyr/sys/util.h>

#include "modules/chassis/chassis_module.h"
#include "modules/imu/hi91_imu_module.h"
#include "modules/ahrs/ahrs.h"
#include "modules/oscilloscope/oscilloscope_module.h"
#include "modules/referee/referee_module.h"
#include "modules/remote_input/remote_input_module.h"
#include "modules/sys_state/sys_state_module.h"
#include "modules/sdlog/sdlog_module.h"
#include <channels/system_status_channel.h>
#include <platform/board/board_identity.h>

LOG_MODULE_REGISTER(app_main, LOG_LEVEL_INF);

#if defined(CONFIG_WBR_CONTROL_RUNTIME_INIT_CAN) && CONFIG_WBR_CONTROL_RUNTIME_INIT_CAN
#include <platform/drivers/communication/can_dispatch.h>
#endif

#if defined(CONFIG_WBR_CONTROL_RUNTIME_INIT_USB) && CONFIG_WBR_CONTROL_RUNTIME_INIT_USB
#include <platform/drivers/communication/usb_session.h>
#endif

namespace
{

void PublishSystemStatus(channels::BootPhase state, uint32_t module_count)
{
	const channels::SystemStatusMessage status = {
		state,
		module_count,
	};
	(void)zbus_chan_pub(&wbr_control_system_status_chan, &status, K_NO_WAIT);
}

} // namespace

/**
 * @brief 按依赖顺序启动平台服务和应用模块。
 * @return 初始化成功后线程永久休眠；启动失败时返回对应负 errno 错误码。
 */
int main(void)
{
	if (IS_ENABLED(CONFIG_WBR_CONTROL_RTT_DIAGNOSTICS)) {
		printk("[printk] wbr_control RTT diagnostics ready\n");
	}
	LOG_INF("wbr_control started on %s", board_identity_name());
	PublishSystemStatus(channels::kBooting, 0U);

	int rc = 0;

#if defined(CONFIG_WBR_CONTROL_RUNTIME_INIT_CAN) && CONFIG_WBR_CONTROL_RUNTIME_INIT_CAN
	if (IS_ENABLED(CONFIG_WBR_CONTROL_RUNTIME_INIT_CAN)) {
		rc = platform::InitializeCanDispatch();
		if (rc != 0) {
			if (rc == -ENODEV) {
				LOG_WRN("can_dispatch init skipped: no CAN device");
			} else {
				LOG_ERR("can_dispatch init failed: %d", rc);
				return rc;
			}
		}
	}
#endif

#if defined(CONFIG_WBR_CONTROL_RUNTIME_INIT_USB) && CONFIG_WBR_CONTROL_RUNTIME_INIT_USB
	if (IS_ENABLED(CONFIG_WBR_CONTROL_RUNTIME_INIT_USB)) {
		rc = platform::InitializeUsbSession();
		if (rc != 0) {
			if (rc == -ENODEV) {
				LOG_WRN("usb_session init skipped: no USB device");
			} else {
				LOG_ERR("usb_session init failed: %d", rc);
				return rc;
			}
		}
	}
#endif

	uint32_t module_count = 0U;

#if defined(CONFIG_WBR_CONTROL_MODULE_SYS_STATE) && CONFIG_WBR_CONTROL_MODULE_SYS_STATE
	{
		static modules::SysStateModule sys_state_module;
		rc = sys_state_module.Start();
		if (rc != 0) {
			LOG_ERR("module start failed: sys_state (%d)", rc);
			return rc;
		}
		++module_count;
	}
#endif
#if defined(CONFIG_WBR_CONTROL_MODULE_REMOTE_INPUT) && CONFIG_WBR_CONTROL_MODULE_REMOTE_INPUT
	{
		static modules::RemoteInputModule remote_input_module;
		rc = remote_input_module.Start();
		if (rc != 0) {
			LOG_ERR("module start failed: remote_input (%d)", rc);
			return rc;
		}
		++module_count;
	}
#endif
#if defined(CONFIG_WBR_CONTROL_MODULE_CHASSIS) && CONFIG_WBR_CONTROL_MODULE_CHASSIS
	{
		static modules::ChassisModule chassis_module;
		rc = chassis_module.Start();
		if (rc != 0) {
			LOG_ERR("module start failed: chassis (%d)", rc);
			return rc;
		}
		++module_count;
	}
#endif
#if defined(CONFIG_WBR_CONTROL_MODULE_REFEREE) && CONFIG_WBR_CONTROL_MODULE_REFEREE
	{
		static modules::RefereeModule referee_module;
		rc = referee_module.Start();
		if (rc != 0) {
			LOG_ERR("module start failed: referee (%d)", rc);
			return rc;
		}
		++module_count;
	}
#endif
	{
		static modules::OscilloscopeModule oscilloscope_module;
		rc = oscilloscope_module.Start();
		if (rc != 0) {
			LOG_ERR("module start failed: oscilloscope (%d)", rc);
			return rc;
		}
		++module_count;
	}
#if defined(CONFIG_WBR_CONTROL_MODULE_HI91_IMU) && CONFIG_WBR_CONTROL_MODULE_HI91_IMU
	{
		static modules::Hi91ImuModule hi91_imu_module;
		rc = hi91_imu_module.Start();
		if (rc != 0) {
			LOG_ERR("module start failed: hi91_imu (%d)", rc);
			return rc;
		}
		++module_count;
	}
#endif
#if defined(CONFIG_WBR_CONTROL_MODULE_AHRS) && CONFIG_WBR_CONTROL_MODULE_AHRS
	{
		static modules::Ahrs ahrs;
		rc = ahrs.Start();
		if (rc != 0) {
			LOG_ERR("module start failed: ahrs (%d)", rc);
			return rc;
		}
		++module_count;
	}
#endif
#if defined(CONFIG_WBR_CONTROL_MODULE_SDLOG) && CONFIG_WBR_CONTROL_MODULE_SDLOG
	{
		static modules::SdLogModule sdlog_module;
		rc = sdlog_module.Start();
		if (rc != 0) {
			LOG_WRN("module start skipped: sdlog (%d)", rc);
		} else {
			++module_count;
		}
	}
#endif
	PublishSystemStatus(channels::kRunning, module_count);

	/* 初始化结束后主线程不再承担周期任务，各模块由自己的线程运行。 */
	k_sleep(K_FOREVER);
	return 0;
}
```
