## CMakeLists.txt
```
cmake_minimum_required(VERSION 3.20.0)

include(${CMAKE_CURRENT_LIST_DIR}/../common/diagnostics.cmake)

find_package(Zephyr REQUIRED HINTS $ENV{ZEPHYR_BASE})
project(can_test)

option(CAN_TEST_LOOPBACK "Run CAN controller in internal loopback mode" OFF)
option(CAN_TEST_ALL_BUSES "Probe all four CAN controllers in one physical-bus image" OFF)
option(CAN_TEST_PIN_PROBE "Probe CAN0/CAN1 TXD to RXD through the transceivers" OFF)
if(CAN_TEST_LOOPBACK)
  target_compile_definitions(app PRIVATE CAN_TEST_LOOPBACK=1)
endif()

if(CAN_TEST_PIN_PROBE)
  target_sources(app PRIVATE src/pin_probe.c)
elseif(CAN_TEST_ALL_BUSES)
  target_sources(app PRIVATE src/all_buses.c)
else()
  target_sources(app PRIVATE src/main.c)
endif()
```

## prj.conf
```kconfig
CONFIG_CONSOLE=y
CONFIG_SERIAL=y
CONFIG_UART_CONSOLE=y
CONFIG_PRINTK=y
CONFIG_DEBUG=y
CONFIG_DEBUG_INFO=y
CONFIG_CAN=y
CONFIG_CAN_FD_MODE=n
```

## app.overlay
```dts
&mcan4 {
	status = "okay";
	pinctrl-0 = <&pinmux_mcan4>;
	pinctrl-names = "default";
	bus-speed = <500000>;
};
```

## src/main.c
```c
/**
 * @file test/can_test/src/main.c
 * @brief 实现应用或测试程序的入口与初始化流程。
 * @details 该文件属于独立 Zephyr 测试镜像，只验证指定外设或算法路径，不会链接进主固件。测试会直接访问目标硬件并通过串口输出判定结果。
 */

#include <errno.h>

#include <zephyr/devicetree.h>
#include <zephyr/device.h>
#include <zephyr/drivers/can.h>
#include <zephyr/drivers/gpio.h>
#include <zephyr/kernel.h>
#include <zephyr/sys/printk.h>
#include <hpm_mcan_drv.h>
#if defined(CONFIG_BOARD_DUST_HPM5E3Y)
#include <hpm_gpio_drv.h>
#include <hpm_soc.h>
#endif

#define TEST_CAN_ID 0x123U

#if DT_NODE_HAS_STATUS(DT_ALIAS(canbus), okay)
#define TEST_CAN_NODE DT_ALIAS(canbus)
#else
#define TEST_CAN_NODE DT_INVALID_NODE
#endif

#define TEST_CAN_BITRATE DT_PROP_OR(TEST_CAN_NODE, bitrate, 1000000)
#define TEST_CAN_PAYLOAD_BYTES 8U

#define TEST_CAN_XCVR_ENABLE_NODE DT_ALIAS(can_transceiver_enable)

K_SEM_DEFINE(g_tx_done_sem, 0, 1);
static volatile int g_tx_result;

static const char *CanStateToStr(enum can_state state)
{
	if (state == CAN_STATE_ERROR_ACTIVE) {
		return "error-active";
	}
	if (state == CAN_STATE_ERROR_WARNING) {
		return "error-warning";
	}
	if (state == CAN_STATE_ERROR_PASSIVE) {
		return "error-passive";
	}
	if (state == CAN_STATE_BUS_OFF) {
		return "bus-off";
	}
	if (state == CAN_STATE_STOPPED) {
		return "stopped";
	}

	return "unknown";
}

static void PrintCanState(const struct device *can_dev, const char *tag)
{
	enum can_state state;
	struct can_bus_err_cnt err_cnt;
	int rc = can_get_state(can_dev, &state, &err_cnt);

	if (rc == 0) {
		printk("[STATE] %s: %s tec=%u rec=%u\n", tag, CanStateToStr(state),
		       err_cnt.tx_err_cnt, err_cnt.rx_err_cnt);
	} else {
		printk("[STATE] %s: can_get_state rc=%d\n", tag, rc);
	}
}

static void PrintCanRegisters(void)
{
	MCAN_Type *can = (MCAN_Type *)DT_REG_ADDR(TEST_CAN_NODE);

	printk("[REG] CCCR=%08x PSR=%08x ECR=%08x IR=%08x TXBRP=%08x TXBTO=%08x\n",
	       can->CCCR, can->PSR, can->ECR, can->IR, can->TXBRP, can->TXBTO);
	printk("[BUS] activity=%u (0=sync 1=idle 2=rx 3=tx) RXD=%u (0=dominant 1=recessive) TEST=%08x\n",
	       MCAN_PSR_ACT_GET(can->PSR), MCAN_TEST_RX_GET(can->TEST), can->TEST);
#if defined(CONFIG_BOARD_DUST_HPM5E3Y)
	printk("[PAD] PD0 func=%08x ctl=%08x level=%u; PD1 func=%08x ctl=%08x level=%u\n",
	       HPM_IOC->PAD[96].FUNC_CTL, HPM_IOC->PAD[96].PAD_CTL,
	       gpio_read_pin(HPM_GPIO0, GPIO_DI_GPIOD, 0),
	       HPM_IOC->PAD[97].FUNC_CTL, HPM_IOC->PAD[97].PAD_CTL,
	       gpio_read_pin(HPM_GPIO0, GPIO_DI_GPIOD, 1));
#endif
}

static void OnTxDone(const struct device *dev, int error, void *user_data)
{
	(void)dev;
	(void)user_data;
	g_tx_result = error;
	k_sem_give(&g_tx_done_sem);
}

static void OnRx(const struct device *dev, struct can_frame *frame, void *user_data)
{
	(void)dev;
	(void)user_data;

	printk("[RX] id=0x%x dlc=%u data=", frame->id, frame->dlc);
	for (uint8_t i = 0; i < can_dlc_to_bytes(frame->dlc); i++) {
		printk("%02x ", frame->data[i]);
	}
	printk("\n");
}

const struct device *FindCanDevice(void)
{
#if DT_NODE_HAS_STATUS(TEST_CAN_NODE, okay)
	const struct device *dev = DEVICE_DT_GET(TEST_CAN_NODE);
	if (device_is_ready(dev)) {
		return dev;
	}
#endif

	return NULL;
}

static int EnableExternalTransceiver(void)
{
#if DT_NODE_HAS_STATUS(TEST_CAN_XCVR_ENABLE_NODE, okay)
	const struct gpio_dt_spec enable_gpio = GPIO_DT_SPEC_GET(TEST_CAN_XCVR_ENABLE_NODE, gpios);
	int rc;

	if (!gpio_is_ready_dt(&enable_gpio)) {
		printk("[FAIL] CAN transceiver enable GPIO is not ready\n");
		return -ENODEV;
	}

	rc = gpio_pin_configure_dt(&enable_gpio, GPIO_OUTPUT_ACTIVE);
	if (rc != 0) {
		printk("[FAIL] configure CAN transceiver enable GPIO rc=%d\n", rc);
		return rc;
	}

	printk("[INFO] CAN transceiver enable GPIO asserted\n");
#else
	printk("[INFO] no can-transceiver-enable alias; assuming transceiver is hardware-enabled\n");
#endif

	return 0;
}

static void PrintCanConfig(const struct device *can_dev)
{
	uint32_t core_clock = 0U;
	int rc = can_get_core_clock(can_dev, &core_clock);

	if (rc == 0) {
		printk("[INFO] CAN core clock: %u Hz\n", core_clock);
	} else {
		printk("[WARN] can_get_core_clock rc=%d\n", rc);
	}

	printk("[INFO] requested bitrate: %u bit/s\n", TEST_CAN_BITRATE);
}

int main(void)
{
	printk("can_test booted\n");

	const struct device *can_dev = FindCanDevice();
	if (can_dev == NULL) {
		printk("[FAIL] CAN device not found\n");
		return -ENODEV;
	}

	printk("using can device: %s\n", can_dev->name);
	PrintCanConfig(can_dev);

#ifdef CAN_TEST_LOOPBACK
	int rc = can_set_mode(can_dev, CAN_MODE_LOOPBACK);
	printk("[INFO] mode: internal loopback (no external CAN traffic)\n");
#else
	int rc = can_set_mode(can_dev, CAN_MODE_NORMAL);
	printk("[INFO] mode: normal (physical CAN bus)\n");
#endif
	if (rc != 0) {
		printk("[FAIL] can_set_mode rc=%d\n", rc);
		return rc;
	}

	rc = can_set_bitrate(can_dev, TEST_CAN_BITRATE);
	if (rc != 0) {
		printk("[FAIL] can_set_bitrate(%u) rc=%d\n", TEST_CAN_BITRATE, rc);
		return rc;
	}

	rc = EnableExternalTransceiver();
	if (rc != 0) {
		return rc;
	}

	rc = can_start(can_dev);
	if ((rc != 0) && (rc != -EALREADY)) {
		printk("[FAIL] can_start rc=%d\n", rc);
		return rc;
	}

	PrintCanState(can_dev, "after start");
	PrintCanRegisters();

	/* Add RX filter for our test ID so we can see loopback/echo replies. */
	struct can_filter rx_filter = {
		.id = TEST_CAN_ID,
		.mask = CAN_STD_ID_MASK,
		.flags = 0U,
	};
	int filter_id = can_add_rx_filter(can_dev, OnRx, NULL, &rx_filter);
	if (filter_id < 0) {
		printk("[WARN] can_add_rx_filter failed: %d\n", filter_id);
	} else {
		printk("[INFO] RX filter installed for id=0x%x (filter_id=%d)\n", TEST_CAN_ID, filter_id);
	}

#ifdef CAN_TEST_LOOPBACK
	printk("[INFO] internal CAN TX/RX test started (id=0x%x)\n", TEST_CAN_ID);
#else
	printk("[INFO] physical CAN TX/RX test started (id=0x%x)\n", TEST_CAN_ID);
	printk("[INFO] connect CAN transceiver and an ACK-capable peer at same baud\n");
#endif

	uint32_t seq = 0U;
	bool tx_blocked = false;
	while (true) {
		if (tx_blocked) {
			PrintCanState(can_dev, "waiting (tx blocked)");
			k_sleep(K_MSEC(1000));
			continue;
		}

		struct can_frame tx = {
			.flags = 0U,
			.id = TEST_CAN_ID,
			.dlc = can_bytes_to_dlc(TEST_CAN_PAYLOAD_BYTES),
			.data = {
				(uint8_t)(seq & 0xFFU),
				(uint8_t)((seq >> 8) & 0xFFU),
				0x32U,
				0x43U,
				0x54U,
				0x65U,
				0x76U,
				0x87U,
			},
		};

		while (k_sem_take(&g_tx_done_sem, K_NO_WAIT) == 0) {
			/* Drain stale completion events before next frame. */
		}

		g_tx_result = -EINPROGRESS;
		rc = can_send(can_dev, &tx, K_MSEC(50), OnTxDone, NULL);
		if (rc != 0) {
			printk("[ERR] can_send enqueue rc=%d (mailbox/state/wiring)\n", rc);
			PrintCanState(can_dev, "enqueue failed");
		} else {
			rc = k_sem_take(&g_tx_done_sem, K_MSEC(200));
			if (rc == 0) {
				if (g_tx_result == 0) {
					printk("[TX] seq=%u id=0x%x dlc=%u\n", seq, tx.id, tx.dlc);
				} else {
					printk("[ERR] tx callback error=%d (likely ACK/bus issue)\n", g_tx_result);
					PrintCanState(can_dev, "tx callback error");
				}
			} else {
				printk("[WARN] tx completion timeout (likely no ACK / transceiver missing)\n");
				PrintCanState(can_dev, "tx timeout");
				PrintCanRegisters();
				rc = can_stop(can_dev);
				if ((rc != 0) && (rc != -EALREADY)) {
					printk("[WARN] can_stop after tx timeout rc=%d\n", rc);
				} else {
					printk("[WARN] CAN stopped after tx timeout to halt hardware retransmit\n");
				}
				printk("[WARN] stop re-sending, keep monitoring state only\n");
				tx_blocked = true;
			}
		}

		seq++;
		k_sleep(K_MSEC(500));
	}
}
```

## src/all_buses.c
```c
/* Physical CAN0-CAN3 probe for the Dust HPM5E3Y board. */
#include <errno.h>
#include <zephyr/device.h>
#include <zephyr/devicetree.h>
#include <zephyr/drivers/can.h>
#include <zephyr/kernel.h>
#include <zephyr/sys/printk.h>
#include <hpm_mcan_drv.h>
#include <hpm_gpio_drv.h>
#include <hpm_soc.h>

struct can_target {
	const char *name;
	const struct device *dev;
	MCAN_Type *regs;
	uint8_t gpio_port;
	uint8_t tx_pin;
	uint8_t rx_pin;
};

static const struct can_target targets[] = {
	{ "CAN0", DEVICE_DT_GET(DT_NODELABEL(can0)), (MCAN_Type *)DT_REG_ADDR(DT_NODELABEL(can0)), GPIO_DI_GPIOD, 0, 1 },
	{ "CAN1", DEVICE_DT_GET(DT_NODELABEL(can1)), (MCAN_Type *)DT_REG_ADDR(DT_NODELABEL(can1)), GPIO_DI_GPIOD, 5, 4 },
	{ "CAN2", DEVICE_DT_GET(DT_NODELABEL(can2)), (MCAN_Type *)DT_REG_ADDR(DT_NODELABEL(can2)), GPIO_DI_GPIOC, 8, 9 },
	{ "CAN3", DEVICE_DT_GET(DT_NODELABEL(can3)), (MCAN_Type *)DT_REG_ADDR(DT_NODELABEL(can3)), GPIO_DI_GPIOC, 15, 14 },
};

K_SEM_DEFINE(tx_done, 0, 1);
static volatile int tx_result;

static void on_tx_done(const struct device *dev, int error, void *user_data)
{
	ARG_UNUSED(dev);
	ARG_UNUSED(user_data);
	tx_result = error;
	k_sem_give(&tx_done);
}

static void on_rx(const struct device *dev, struct can_frame *frame, void *user_data)
{
	const struct can_target *target = user_data;
	ARG_UNUSED(dev);
	printk("[%s RX] id=0x%x dlc=%u\n", target->name, frame->id, frame->dlc);
}

static void print_status(const struct can_target *target, const char *phase)
{
	enum can_state state;
	struct can_bus_err_cnt errors;
	int rc = can_get_state(target->dev, &state, &errors);
	MCAN_Type *can = target->regs;
	uint32_t rx_pad_index = (target->gpio_port * 32U) + target->rx_pin;
	uint32_t tx_pad_index = (target->gpio_port * 32U) + target->tx_pin;

	printk("[%s %s] state=%d rc=%d tec=%u rec=%u activity=%u LEC=%u RXD=%u GPIO_RX=%u GPIO_TX=%u\n",
	       target->name, phase, state, rc, errors.tx_err_cnt, errors.rx_err_cnt,
	       MCAN_PSR_ACT_GET(can->PSR), MCAN_PSR_LEC_GET(can->PSR),
	       MCAN_TEST_RX_GET(can->TEST),
	       gpio_read_pin(HPM_GPIO0, target->gpio_port, target->rx_pin),
	       gpio_read_pin(HPM_GPIO0, target->gpio_port, target->tx_pin));
	printk("[%s REG] CCCR=%08x PSR=%08x ECR=%08x IR=%08x TXBRP=%08x TXBTO=%08x\n",
	       target->name, can->CCCR, can->PSR, can->ECR, can->IR, can->TXBRP, can->TXBTO);
	printk("[%s PAD] TX_FUNC=%08x TX_CTL=%08x RX_FUNC=%08x RX_CTL=%08x\n",
	       target->name, HPM_IOC->PAD[tx_pad_index].FUNC_CTL,
	       HPM_IOC->PAD[tx_pad_index].PAD_CTL,
	       HPM_IOC->PAD[rx_pad_index].FUNC_CTL,
	       HPM_IOC->PAD[rx_pad_index].PAD_CTL);
}

static void probe_one(const struct can_target *target)
{
	int rc;
	struct can_filter filter = { .id = 0, .mask = 0, .flags = 0 };
	struct can_frame frame = {
		.id = 0x123,
		.dlc = 8,
		.data = { 0x43, 0x41, 0x4e, target->name[3], 0x54, 0x45, 0x53, 0x54 },
	};

	printk("[%s] device=%s ready=%u\n", target->name, target->dev->name,
	       device_is_ready(target->dev));
	if (!device_is_ready(target->dev)) {
		return;
	}
	rc = can_set_mode(target->dev, CAN_MODE_NORMAL);
	if (rc == 0) {
		rc = can_set_bitrate(target->dev, 1000000);
	}
	if (rc == 0) {
		rc = can_add_rx_filter(target->dev, on_rx, (void *)target, &filter);
		if (rc >= 0) {
			rc = 0;
		}
	}
	if (rc == 0) {
		rc = can_start(target->dev);
	}
	if (rc != 0) {
		printk("[%s] setup failed rc=%d\n", target->name, rc);
		return;
	}

	print_status(target, "before TX");
	k_sem_reset(&tx_done);
	tx_result = -EINPROGRESS;
	rc = can_send(target->dev, &frame, K_MSEC(50), on_tx_done, NULL);
	printk("[%s] can_send rc=%d\n", target->name, rc);
	if (rc == 0) {
		rc = k_sem_take(&tx_done, K_MSEC(300));
		printk("[%s] completion wait rc=%d callback=%d\n", target->name, rc, tx_result);
	}
	print_status(target, "after TX");
	rc = can_stop(target->dev);
	printk("[%s] stopped rc=%d\n", target->name, rc);
}

int main(void)
{
	printk("CAN0-CAN3 physical probe: 1 Mbps, one frame per controller\n");
	for (size_t i = 0; i < ARRAY_SIZE(targets); ++i) {
		probe_one(&targets[i]);
		k_sleep(K_MSEC(300));
	}
	printk("CAN0-CAN3 probe complete; RTT shell remains available\n");
	return 0;
}
```

## src/pin_probe.c
```c
/* Brief GPIO-level TXD/RXD probe for HPM5E3Y CAN0/1, with CAN2 as a control. */
#include <stdint.h>
#include <zephyr/kernel.h>
#include <zephyr/sys/printk.h>
#include <hpm_gpio_drv.h>
#include <hpm_soc.h>

struct pin_probe_target {
	const char *name;
	uint8_t port;
	uint8_t tx_pin;
	uint8_t rx_pin;
};

static const struct pin_probe_target targets[] = {
	{ "CAN0", GPIO_DI_GPIOD, 0, 1 },
	{ "CAN1", GPIO_DI_GPIOD, 5, 4 },
	{ "CAN2", GPIO_DI_GPIOC, 8, 9 },
};

static void probe_one(const struct pin_probe_target *target)
{
	const uint32_t port = target->port;
	const uint32_t tx_pad = (port * 32U) + target->tx_pin;
	const uint32_t rx_pad = (port * 32U) + target->rx_pin;
	const uint32_t tx_mask = 1UL << target->tx_pin;
	uint32_t saved_func = HPM_IOC->PAD[tx_pad].FUNC_CTL;
	uint32_t saved_rx_ctl = HPM_IOC->PAD[rx_pad].PAD_CTL;
	uint32_t saved_oe = HPM_GPIO0->OE[port].VALUE & tx_mask;
	uint32_t saved_out = HPM_GPIO0->DO[port].VALUE & tx_mask;
	uint8_t idle_rx = gpio_read_pin(HPM_GPIO0, port, target->rx_pin);
	uint8_t high_tx, high_rx, low_tx, low_rx, release_rx;
	uint8_t pull_up_rx, pull_down_rx, restored_rx;

	/* Start recessive, then switch only TXD to GPIO. RXD stays on MCAN mux. */
	gpio_write_pin(HPM_GPIO0, port, target->tx_pin, 1);
	gpio_set_pin_output(HPM_GPIO0, port, target->tx_pin);
	HPM_IOC->PAD[tx_pad].FUNC_CTL = IOC_PAD_FUNC_CTL_LOOP_BACK_SET(1);
	k_busy_wait(100);
	high_tx = gpio_read_pin(HPM_GPIO0, port, target->tx_pin);
	high_rx = gpio_read_pin(HPM_GPIO0, port, target->rx_pin);

	/* A 100 us dominant pulse is enough to check the transceiver echo. */
	gpio_write_pin(HPM_GPIO0, port, target->tx_pin, 0);
	k_busy_wait(100);
	low_tx = gpio_read_pin(HPM_GPIO0, port, target->tx_pin);
	low_rx = gpio_read_pin(HPM_GPIO0, port, target->rx_pin);
	gpio_write_pin(HPM_GPIO0, port, target->tx_pin, 1);
	k_busy_wait(100);
	release_rx = gpio_read_pin(HPM_GPIO0, port, target->rx_pin);

	HPM_IOC->PAD[tx_pad].FUNC_CTL = saved_func;
	if (saved_out == 0U) {
		gpio_write_pin(HPM_GPIO0, port, target->tx_pin, 0);
	}
	if (saved_oe == 0U) {
		gpio_set_pin_input(HPM_GPIO0, port, target->tx_pin);
	}
	/* Disable the pad keeper while applying weak pulls; otherwise its held
	 * value can hide a floating RXD. Restore the original pad setting below.
	 */
	HPM_IOC->PAD[rx_pad].PAD_CTL =
		(saved_rx_ctl & ~(IOC_PAD_PAD_CTL_PE_MASK | IOC_PAD_PAD_CTL_PS_MASK |
		                  IOC_PAD_PAD_CTL_PRS_MASK | IOC_PAD_PAD_CTL_KE_MASK)) |
		IOC_PAD_PAD_CTL_PE_SET(1) | IOC_PAD_PAD_CTL_PS_SET(1);
	k_busy_wait(1000);
	pull_up_rx = gpio_read_pin(HPM_GPIO0, port, target->rx_pin);
	HPM_IOC->PAD[rx_pad].PAD_CTL =
		(saved_rx_ctl & ~(IOC_PAD_PAD_CTL_PE_MASK | IOC_PAD_PAD_CTL_PS_MASK |
		                  IOC_PAD_PAD_CTL_PRS_MASK | IOC_PAD_PAD_CTL_KE_MASK)) |
		IOC_PAD_PAD_CTL_PE_SET(1);
	k_busy_wait(1000);
	pull_down_rx = gpio_read_pin(HPM_GPIO0, port, target->rx_pin);
	HPM_IOC->PAD[rx_pad].PAD_CTL = saved_rx_ctl;
	k_busy_wait(100);
	restored_rx = gpio_read_pin(HPM_GPIO0, port, target->rx_pin);
	printk("[%s PIN] idle RX=%u; TXD high: TX=%u RX=%u; TXD low: TX=%u RX=%u; released RX=%u\n",
	       target->name, idle_rx, high_tx, high_rx, low_tx, low_rx, release_rx);
	printk("[%s BIAS] pull-up RX=%u pull-down RX=%u restored RX=%u\n",
	       target->name, pull_up_rx, pull_down_rx, restored_rx);
	printk("[%s PIN] TX_FUNC restored=%08x RX_FUNC=%08x\n", target->name,
	       HPM_IOC->PAD[tx_pad].FUNC_CTL,
	       HPM_IOC->PAD[rx_pad].FUNC_CTL);
}

int main(void)
{
	printk("CAN0/CAN1/CAN2 TXD-to-RXD pin probe (100 us pulse per channel)\n");
	for (size_t i = 0; i < ARRAY_SIZE(targets); ++i) {
		probe_one(&targets[i]);
		k_sleep(K_MSEC(20));
	}
	printk("CAN pin probe complete; RTT shell remains available\n");
	return 0;
}
```
